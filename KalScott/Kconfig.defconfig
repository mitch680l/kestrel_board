## KalScott/Kconfig.defconfig
```kconfig
# Kestrel nRF9151 board configuration
#
# Copyright (c) 2024 Nordic Semiconductor
# SPDX-License-Identifier: LicenseRef-Nordic-5-Clause

rsource "Kconfig.defconfig.nrf9151"


if !IS_BOOTLOADER_IMG

# For on-board regulators
config REGULATOR
	default y



# GPIO hogs must be initialized after nPM1300 (GPIO_NPM1300_INIT_PRIORITY)
config GPIO_HOGS_INIT_PRIORITY
	default 86

endif # !IS_BOOTLOADER_IMG
```

## KalScott/Kconfig.sysbuild
```kconfig
# Copyright (c) 2024 Nordic Semiconductor ASA
# SPDX-License-Identifier: LicenseRef-Nordic-5-Clause

choice BOOTLOADER
	default BOOTLOADER_MCUBOOT if KESTREL_STATIC_PARTITIONS_FACTORY
endchoice

choice
	prompt "Pre-defined Kestrel partition layout"
	default KESTREL_STATIC_PARTITIONS_FACTORY

config KESTREL_STATIC_PARTITIONS_FACTORY
	bool "Factory Kestrel partition layout"

config KESTREL_NO_PREDEFINED_LAYOUT
	bool "None [EXPERIMENTAL]"
	select EXPERIMENTAL
endchoice

if BOARD_KESTREL_NRF9151 || BOARD_KESTREL_NRF9151_NS

config SECURE_BOOT_APPCORE
	default y if KESTREL_STATIC_PARTITIONS_FACTORY

config PM_EXTERNAL_FLASH_MCUBOOT_SECONDARY
	default y if BOOTLOADER_MCUBOOT

config PM_OVERRIDE_EXTERNAL_DRIVER_CHECK
	default y if BOOTLOADER_MCUBOOT

endif # BOARD_KESTREL_NRF9151 || BOARD_KESTREL_NRF9151_NS
```
